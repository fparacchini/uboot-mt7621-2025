## configs/wsm20_defconfig
```kconfig
CONFIG_MIPS=y
CONFIG_SOC_MT7621=y
CONFIG_BOARD_ZYXEL_WSM20=y

# Indirizzi base
CONFIG_SYS_TEXT_BASE=0xBC000000
CONFIG_SYS_SDRAM_BASE=0x80000000
CONFIG_SYS_SDRAM_SIZE=0x10000000   # 256 MB
CONFIG_SYS_LOAD_ADDR=0x80001000    # Kernel load address
CONFIG_BOOTCOMMAND="bootm 0x80001000"

# Frequenze (coerenti con bootloader Zyxel)
CONFIG_SYS_CPU_FREQ=880000000      # 880 MHz
CONFIG_SYS_DRAM_FREQ=1200000000    # DDR3-1200 (600 MHz clock, 1200 MT/s)
CONFIG_SYS_BUS_FREQ=220000000      # Bus/axi freq

# NAND flash
CONFIG_SYS_NAND_PAGE_SIZE=2048
CONFIG_SYS_NAND_BLOCK_SIZE=131072
CONFIG_SYS_NAND_BAD_BLOCK_POS=0
CONFIG_SYS_NAND_U_BOOT_OFFS=0x0
CONFIG_ENV_IS_IN_NAND=y
CONFIG_ENV_OFFSET=0x100000         # in "Config" partition
CONFIG_ENV_SIZE=0x10000

# Tabella MTD (dal log OpenWrt)
CONFIG_MTDIDS_DEFAULT="nand0=mt7621-nand"
CONFIG_MTDPARTS_DEFAULT="mtdparts=nand0:1024k(bootloader),1024k(config),1792k(factory),40000k(firmware),40000k(kernel2),1024k(persist),4096k(rootfs_data),38912k(app),1024k(crt)"

# Console
CONFIG_BAUDRATE=115200
CONFIG_DEFAULT_CONSOLE="ttyS0"

# Ethernet e switch
CONFIG_MT7621_ETH=y
CONFIG_MT7530_SWITCH=y

# Comandi NAND / UBI
CONFIG_CMD_NAND=y
CONFIG_CMD_UBI=y
CONFIG_CMD_UBIFS=y

# GPIO (reset e LED per Linux/OpenWrt)
CONFIG_BUTTON_RESET_GPIO=18
CONFIG_LED_SYSTEM_GPIO=14

# Funzioni utili
CONFIG_CMD_PING=y
CONFIG_CMD_TFTPBOOT=y
CONFIG_CMD_SAVEENV=y
CONFIG_CMD_HTTPD=y
CONFIG_CMD_NET=y
CONFIG_CMD_DHCP=y
```
